/**
 * Generated by C-Next Transpiler from: TimingDebugHandler.cnx
 * A safer C for embedded systems
 */

#include "Domain/TimingDebugHandler.hpp"

/**
 * Timing Debug Handler
 * Monitors loop timing and reports max execution durations
 * Wrap with #ifdef DEBUG_TIMING to exclude from release builds
 */
#include <Arduino.h>
#include <AppConfig.hpp>

#include <stdint.h>

/* Scope: TimingDebugHandler */
static elapsedMicros TimingDebugHandler_phaseTimer = {};
static elapsedMillis TimingDebugHandler_reportTimer = {};
static uint32_t TimingDebugHandler_currentSensor = 0U;
static uint32_t TimingDebugHandler_maxSensor = 0U;
static uint32_t TimingDebugHandler_currentSerial = 0U;
static uint32_t TimingDebugHandler_maxSerial = 0U;
static uint32_t TimingDebugHandler_currentJ1939 = 0U;
static uint32_t TimingDebugHandler_maxJ1939 = 0U;
static uint32_t TimingDebugHandler_maxTotal = 0U;

void TimingDebugHandler_initialize(void) {
    TimingDebugHandler_reportTimer = 0;
    TimingDebugHandler_currentSensor = 0U;
    TimingDebugHandler_maxSensor = 0U;
    TimingDebugHandler_currentSerial = 0U;
    TimingDebugHandler_maxSerial = 0U;
    TimingDebugHandler_currentJ1939 = 0U;
    TimingDebugHandler_maxJ1939 = 0U;
    TimingDebugHandler_maxTotal = 0U;
}

void TimingDebugHandler_startSensor(void) {
    TimingDebugHandler_phaseTimer = 0;
}

void TimingDebugHandler_finishSensor(void) {
    TimingDebugHandler_currentSensor = TimingDebugHandler_phaseTimer;
    if (TimingDebugHandler_currentSensor > TimingDebugHandler_maxSensor) {
        TimingDebugHandler_maxSensor = TimingDebugHandler_currentSensor;
    }
}

void TimingDebugHandler_startSerial(void) {
    TimingDebugHandler_phaseTimer = 0;
}

void TimingDebugHandler_finishSerial(void) {
    TimingDebugHandler_currentSerial = TimingDebugHandler_phaseTimer;
    if (TimingDebugHandler_currentSerial > TimingDebugHandler_maxSerial) {
        TimingDebugHandler_maxSerial = TimingDebugHandler_currentSerial;
    }
}

void TimingDebugHandler_startJ1939(void) {
    TimingDebugHandler_phaseTimer = 0;
}

void TimingDebugHandler_finishJ1939(void) {
    TimingDebugHandler_currentJ1939 = TimingDebugHandler_phaseTimer;
    if (TimingDebugHandler_currentJ1939 > TimingDebugHandler_maxJ1939) {
        TimingDebugHandler_maxJ1939 = TimingDebugHandler_currentJ1939;
    }
}

void TimingDebugHandler_maybeReport(void) {
    uint32_t currentTotal = TimingDebugHandler_currentSensor + TimingDebugHandler_currentSerial + TimingDebugHandler_currentJ1939;
    if (currentTotal > TimingDebugHandler_maxTotal) {
        TimingDebugHandler_maxTotal = currentTotal;
    }
    if (TimingDebugHandler_reportTimer >= 5000) {
        Serial.print("LOOP us max: sensor=");
        Serial.print(TimingDebugHandler_maxSensor);
        Serial.print(" serial=");
        Serial.print(TimingDebugHandler_maxSerial);
        Serial.print(" j1939=");
        Serial.print(TimingDebugHandler_maxJ1939);
        Serial.print(" total=");
        Serial.println(TimingDebugHandler_maxTotal);
        TimingDebugHandler_maxSensor = 0U;
        TimingDebugHandler_maxSerial = 0U;
        TimingDebugHandler_maxJ1939 = 0U;
        TimingDebugHandler_maxTotal = 0U;
        TimingDebugHandler_reportTimer = 0;
    }
}
